## buildroot/knulli-capture/Config.in
```kconfig
config BR2_PACKAGE_KNULLI_CAPTURE
	bool "knulli-capture"
	depends on BR2_aarch64
	depends on BR2_TOOLCHAIN_HAS_THREADS # x264
	select BR2_PACKAGE_ZLIB
	select BR2_PACKAGE_X264
	select BR2_PACKAGE_OPUS
	select BR2_PACKAGE_VO_AACENC
	select BR2_PACKAGE_PULSEAUDIO # headers; libpulse-simple is dlopen'ed

	help
	  knulli-screenshot and knulli-record: capture the screen(s) to
	  PNG, or record them with sound to MKV (H.264 + Opus) or MP4
	  (H.264 + AAC), reading the scanout buffers directly through
	  DRM/KMS or fbdev. Uses the Rockchip RGA (librga, if present)
	  and the Allwinner display engine for conversion where available.

	  https://github.com/dopazz/knulli-capture
```
